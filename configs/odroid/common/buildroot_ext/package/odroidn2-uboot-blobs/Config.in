## configs/odroid/common/buildroot_ext/package/odroidn2-uboot-blobs/Config.in
```kconfig
config BR2_PACKAGE_ODROIDN2_UBOOT_BLOBS
	bool "odroidn2-uboot-blobs"
	help
	  Pre-compiled u-boot for odroid n2.
```

## configs/odroid/common/buildroot_ext/package/odroidxu-uboot-blobs/Config.in
```kconfig
config BR2_PACKAGE_ODROIDXU_UBOOT_BLOBS
	bool "odroidxu-uboot-blobs"
	help
	  Trust zone blobs for u-boot for odroid xu.
```

## configs/odroid/common/buildroot_ext/package/rkbin-firmware/Config.in
```kconfig
config BR2_PACKAGE_RKBIN_FIRMWARE
	bool "rkbin-firmware"
	help
	  Rockchip boot firmware.

	  https://github.com/skiffos/rkbin

if BR2_PACKAGE_RKBIN_FIRMWARE

config BR2_PACKAGE_RKBIN_FIRMWARE_TARGET
	string "rkbin target name"
	default "rk35"
	help
	  Target and subdirectory name in rkbin.

endif # BR2_PACKAGE_RKBIN_FIRMWARE
```

## configs/pine64/common/buildroot_ext/Config.in
```kconfig
source "$BR2_EXTERNAL_PINE64_COMMON_PATH/package/ap6256-firmware/Config.in"
source "$BR2_EXTERNAL_PINE64_COMMON_PATH/package/atinout/Config.in"
source "$BR2_EXTERNAL_PINE64_COMMON_PATH/package/pinephone-firmware/Config.in"
source "$BR2_EXTERNAL_PINE64_COMMON_PATH/package/rk3399-firmware-blobs/Config.in"
source "$BR2_EXTERNAL_PINE64_COMMON_PATH/package/rtl8723bt-firmware/Config.in"
source "$BR2_EXTERNAL_PINE64_COMMON_PATH/package/rtl8723cs/Config.in"
```

## configs/pine64/common/buildroot_ext/package/ap6256-firmware/Config.in
```kconfig
config BR2_PACKAGE_AP6256_FIRMWARE
	bool "ap6256-firmware"
	help
	  This package provides binary firmware files (closed blobs)
	  for ap6256 cards.

	  https://github.com/paralin/ap6256-firmware
```

## configs/pine64/common/buildroot_ext/package/atinout/Config.in
```kconfig
config BR2_PACKAGE_ATINOUT
	bool "atinout"
	help
	  atinout tool for AT commands

	  http://atinout.sourceforge.net/
```

## configs/pine64/common/buildroot_ext/package/pinebook-a64-uboot/Config.in
```kconfig
config BR2_PACKAGE_PINEBOOK_A64_UBOOT
	bool "pinebook-a64 crust u-boot blobs"
	help
	  Binary blobs for Pinebook A64 U-boot with crust

	  https://dl.slarm64.org/slackware/images/pinebook/
```

## configs/pine64/common/buildroot_ext/package/pinephone-crust-blobs/Config.in
```kconfig
config BR2_PACKAGE_PINEPHONE_CRUST_BLOBS
	bool "pinephone crust u-boot blobs"
	help
	  Binary blobs for PinePhone U-boot with crust support

	  https://gitlab.com/skiffos/pinephone-crust-blobs
```

## configs/pine64/common/buildroot_ext/package/pinephone-firmware/Config.in
```kconfig
config BR2_PACKAGE_PINEPHONE_FIRMWARE
	bool "pinephone-firmware"
	select BR2_PACKAGE_LINUX_FIRMWARE
	help
	  This package provides binary firmware files (closed blobs)
	  for the PinePhone camera and other hardware.

	  https://megous.com/git/linux-firmware/
```

## configs/pine64/common/buildroot_ext/package/rk3399-firmware-blobs/Config.in
```kconfig
config BR2_PACKAGE_RK3399_FIRMWARE_BLOBS
	bool "rk3399 firmware blobs"
	help
	  Binary blobs for rk3399 bl31

	  https://github.com/skiffos/rk3399-firmware-blobs

if BR2_PACKAGE_RK3399_FIRMWARE_BLOBS

config BR2_PACKAGE_RK3399_FIRMWARE_BLOBS_VARIANT
	string "board variant"
	default "pinebook-pro"

endif # BR2_PACKAGE_RK3399_FIRMWARE_BLOBS
```

## configs/pine64/common/buildroot_ext/package/rtk-hciattach/Config.in
```kconfig
config BR2_PACKAGE_RTK_HCIATTACH
	bool "rtk-hciattach"
	depends on !BR2_TOOLCHAIN_USES_UCLIBC
	help
	  Realtek H5 bluetooth support
```

## configs/pine64/common/buildroot_ext/package/rtl8723bt-firmware/Config.in
```kconfig
config BR2_PACKAGE_RTL8723BT_FIRMWARE
	bool "rtl8723bt-firmware"
	help
	  This package provides binary firmware files (closed blobs)
	  for rtl8723bt cards.

	  https://github.com/paralin/rtl8723bt-firmware
```

## configs/pine64/common/buildroot_ext/package/rtl8723cs/Config.in
```kconfig
comment "rtl8723cs needs a Linux kernel to be built"
	depends on !BR2_LINUX_KERNEL

config BR2_PACKAGE_RTL8723CS
	bool "rtl8723cs"
	depends on BR2_LINUX_KERNEL
	select BR2_PACKAGE_RTL8723BT_FIRMWARE
	help
	  rtl8723cs wifi driver

	  https://github.com/paralin/rtl8723cs
```

## configs/skiff/core/buildroot_ext/Config.in
```kconfig
source "$BR2_EXTERNAL_SKIFF_CORE_PATH/package/skiff-core/Config.in"
source "$BR2_EXTERNAL_SKIFF_CORE_PATH/package/skiff-core-defconfig/Config.in"
source "$BR2_EXTERNAL_SKIFF_CORE_PATH/package/skiff-dbus-proxy/Config.in"
```

## configs/skiff/core/buildroot_ext/package/skiff-core-defconfig/Config.in
```kconfig
config BR2_PACKAGE_SKIFF_CORE_DEFCONFIG
	bool "skiff-core-defconfig"
	depends on BR2_PACKAGE_HOST_GO_TARGET_ARCH_SUPPORTS
	depends on BR2_PACKAGE_HOST_GO_TARGET_CGO_LINKING_SUPPORTS
	depends on BR2_TOOLCHAIN_HAS_THREADS
	depends on !BR2_TOOLCHAIN_USES_UCLIBC # docker-containerd -> runc
	depends on BR2_USE_MMU # docker-containerd
	select BR2_PACKAGE_DOCKER_ENGINE # skiff-core
	select BR2_PACKAGE_CONTAINERD # skiff-core
	select BR2_PACKAGE_DOCKER_PROXY # skiff-core
	select BR2_PACKAGE_IPTABLES # skiff-core
	select BR2_PACKAGE_SKIFF_CORE
	help
	  Skiff Core environment default config.

	  https://github.com/skiffos/skiff-core

comment "skiff-core-defconfig needs a glibc toolchain w/ threads"
	depends on BR2_PACKAGE_HOST_GO_TARGET_ARCH_SUPPORTS
	depends on BR2_PACKAGE_HOST_GO_TARGET_CGO_LINKING_SUPPORTS
	depends on !BR2_TOOLCHAIN_HAS_THREADS || !BR2_TOOLCHAIN_USES_GLIBC
```

## configs/skiff/core/buildroot_ext/package/skiff-core/Config.in
```kconfig
config BR2_PACKAGE_SKIFF_CORE
	bool "skiff-core"
	depends on BR2_PACKAGE_HOST_GO_TARGET_ARCH_SUPPORTS
	depends on BR2_PACKAGE_HOST_GO_TARGET_CGO_LINKING_SUPPORTS
	depends on BR2_TOOLCHAIN_HAS_THREADS
	depends on !BR2_TOOLCHAIN_USES_UCLIBC # docker-containerd -> runc
	depends on BR2_USE_MMU # docker-containerd
	select BR2_PACKAGE_DOCKER_ENGINE # runtime dependency
	select BR2_PACKAGE_CONTAINERD # runtime dependency
	select BR2_PACKAGE_DOCKER_PROXY # runtime dependency
	select BR2_PACKAGE_IPTABLES # runtime dependency
	help
	  Skiff Core manages setting up user environment containers
	  on embedded systems. It allows users to work inside familiar environments
	  in a modular and easy to configure way.

	  https://github.com/skiffos/skiff-core

comment "skiff-core needs a glibc or musl toolchain w/ threads"
	depends on BR2_PACKAGE_HOST_GO_TARGET_ARCH_SUPPORTS
	depends on BR2_PACKAGE_HOST_GO_TARGET_CGO_LINKING_SUPPORTS
	depends on !BR2_TOOLCHAIN_HAS_THREADS || BR2_TOOLCHAIN_USES_UCLIBC
	depends on BR2_USE_MMU
```

## configs/skiff/core/buildroot_ext/package/skiff-dbus-proxy/Config.in
```kconfig
config BR2_PACKAGE_SKIFF_DBUS_PROXY
	bool "skiff-dbus-proxy"
	depends on BR2_PACKAGE_SYSTEMD
	depends on BR2_TOOLCHAIN_HAS_THREADS # systemd
	depends on BR2_USE_MMU # systemd
	help
	  Forward selected host D-Bus services into Skiff Core containers.

	  https://github.com/skiffos/skiff-dbus-proxy

comment "skiff-dbus-proxy needs systemd"
	depends on !BR2_PACKAGE_SYSTEMD
```

## configs/skiff/standard/buildroot_ext/package/screen-fetch/Config.in
```kconfig
config BR2_PACKAGE_SCREEN_FETCH
	bool "screen-fetch"
	depends on BR2_USE_MMU # bash
	depends on BR2_PACKAGE_BUSYBOX_SHOW_OTHERS # bash
	select BR2_PACKAGE_BASH # runtime dependency
	help
	  Screen Fetch is a bash script to display distro info.

	  https://github.com/KittyKatt/screenFetch
```
