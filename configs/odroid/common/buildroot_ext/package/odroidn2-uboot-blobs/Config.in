## configs/util/argon1/buildroot_ext/package/argononed/Config.in
```kconfig
config BR2_PACKAGE_ARGONONED
	bool "argononed"
	depends on !BR2_STATIC_LIBS # rpi-userland
	depends on BR2_arm || BR2_aarch64 # rpi-userland
	depends on BR2_INSTALL_LIBSTDCPP # rpi-userland
	depends on BR2_PACKAGE_BUSYBOX_SHOW_OTHERS # i2c-tools
	depends on BR2_TOOLCHAIN_HAS_THREADS # rpi-userland libffi
	select BR2_PACKAGE_I2C_TOOLS
	select BR2_PACKAGE_LIBFFI
	select BR2_PACKAGE_LM_SENSORS
	select BR2_PACKAGE_PYTHON3
	select BR2_PACKAGE_PYTHON_RPI_GPIO
	select BR2_PACKAGE_PYTHON_SMBUS_CFFI
	# TODO: removed in 2026, need a replacement? check...
	# select BR2_PACKAGE_RPI_USERLAND
	help
	  argononed is a daemon to control the Argon One case fans.

	  https://www.argon40.com/argon-one-raspberry-pi-4-case.html

comment "argononed needs rpi-userland and threads to work"
	depends on BR2_arm || BR2_aarch64
	depends on !BR2_INSTALL_LIBSTDCPP || !BR2_TOOLCHAIN_HAS_THREADS || \
		BR2_STATIC_LIBS
```

## configs/valve/deck/buildroot_ext/package/linux-firmware-neptune/Config.in
```kconfig
config BR2_PACKAGE_LINUX_FIRMWARE_NEPTUNE
	bool "linux-firmware-neptune"
	select BR2_PACKAGE_LINUX_FIRMWARE
	help
	  This package provides binary firmware files (closed blobs)
	  for the Valve Deck (codenamed neptune).

	  https://steamdeck-packages.steamos.cloud/archlinux-mirror/sources/jupiter-main/
```

## configs/virt/v86min/kernel_defconfig
```kconfig
# v86-minimal: complete kernel defconfig
# This is a standalone config, not fragments. Used via
# BR2_LINUX_KERNEL_USE_CUSTOM_CONFIG.

# === Architecture ===
CONFIG_X86_GENERIC=y
CONFIG_PROCESSOR_SELECT=y
# CONFIG_X86_EXTENDED_PLATFORM is not set
# CONFIG_SMP is not set
# CONFIG_DMI is not set
# CONFIG_ACPI is not set
# CONFIG_MICROCODE is not set
# CONFIG_SUSPEND is not set
# CONFIG_HIBERNATION is not set
# CONFIG_PM is not set
# CONFIG_CPU_SUP_CYRIX_32 is not set
# CONFIG_CPU_SUP_HYGON is not set
# CONFIG_CPU_SUP_CENTAUR is not set
# CONFIG_CPU_SUP_TRANSMETA_32 is not set
# CONFIG_CPU_SUP_UMC_32 is not set
# CONFIG_CPU_SUP_ZHAOXIN is not set
# CONFIG_CPU_SUP_VORTEX_32 is not set

# === Boot ===
CONFIG_BLK_DEV_INITRD=y
CONFIG_DEVTMPFS=y
CONFIG_DEVTMPFS_MOUNT=y
CONFIG_RD_GZIP=y
CONFIG_RD_LZ4=y

# === Serial console (v86 UART) ===
CONFIG_SERIAL_8250=y
CONFIG_SERIAL_8250_CONSOLE=y
CONFIG_SERIAL_8250_NR_UARTS=4

# === PCI (required for virtio + NE2K) ===
CONFIG_PCI=y
# CONFIG_PCIEPORTBUS is not set
# CONFIG_HOTPLUG_PCI is not set
# CONFIG_PCI_MSI is not set

# === NE2K (v86 NIC) ===
CONFIG_NE2K_PCI=y
CONFIG_NETDEVICES=y

# === Core networking ===
CONFIG_NET=y
CONFIG_INET=y
CONFIG_IPV6=y
CONFIG_PACKET=y
CONFIG_UNIX=y
CONFIG_IP_PNP=y
CONFIG_IP_PNP_DHCP=y

# === Explicitly disable network bloat ===
# CONFIG_NETFILTER is not set
# CONFIG_NET_SCHED is not set
# CONFIG_NET_CLS is not set
# CONFIG_BRIDGE is not set
# CONFIG_IP_ADVANCED_ROUTER is not set
# CONFIG_IP_MULTICAST is not set
# CONFIG_XFRM_USER is not set
# CONFIG_INET_AH is not set
# CONFIG_INET_ESP is not set
# CONFIG_INET_IPCOMP is not set
# CONFIG_MPTCP is not set
# CONFIG_6LOWPAN is not set
# CONFIG_BATMAN_ADV is not set
# CONFIG_OPENVSWITCH is not set
# CONFIG_VXLAN is not set
# CONFIG_VETH is not set
# CONFIG_MACVLAN is not set
# CONFIG_IPVLAN is not set
# CONFIG_IP_DCCP is not set
# CONFIG_IP_SCTP is not set
# CONFIG_WIREGUARD is not set
# CONFIG_NETLABEL is not set
# CONFIG_NETCONSOLE is not set
# CONFIG_MPLS is not set

# === Virtio (9p transport) ===
CONFIG_VIRTIO=y
CONFIG_VIRTIO_PCI=y
CONFIG_VIRTIO_NET=y
CONFIG_VIRTIO_BALLOON=y
CONFIG_VIRTIO_MMIO=y

# === 9p filesystem (root mount) ===
CONFIG_9P_FS=y
CONFIG_9P_FS_POSIX_ACL=y
CONFIG_NET_9P=y
CONFIG_NET_9P_VIRTIO=y

# === Core filesystems ===
CONFIG_TMPFS=y
CONFIG_TMPFS_POSIX_ACL=y
CONFIG_PROC_FS=y
CONFIG_SYSFS=y
CONFIG_DEVPTS_FS=y
CONFIG_EXT4_FS=y

# === Explicitly disable unneeded FS ===
# CONFIG_OVERLAY_FS is not set
# CONFIG_FUSE_FS is not set
# CONFIG_NFS_FS is not set
# CONFIG_BTRFS_FS is not set
# CONFIG_XFS_FS is not set
# CONFIG_MSDOS_FS is not set
# CONFIG_VFAT_FS is not set
# CONFIG_ISO9660_FS is not set
# CONFIG_BINFMT_MISC is not set
# CONFIG_AUTOFS_FS is not set

# === Timers ===
CONFIG_HIGH_RES_TIMERS=y
CONFIG_NO_HZ=y

# === Misc required ===
CONFIG_COMPAT_32BIT_TIME=y
CONFIG_INPUT_EVDEV=y
CONFIG_TTY=y
CONFIG_VT=y
CONFIG_VT_CONSOLE=y
CONFIG_PRINTK=y
CONFIG_BLK_DEV_LOOP=y
CONFIG_EPOLL=y
CONFIG_SIGNALFD=y
CONFIG_TIMERFD=y
CONFIG_INOTIFY_USER=y
CONFIG_FANOTIFY=y
CONFIG_FHANDLE=y
CONFIG_SYSVIPC=y
CONFIG_UNIX98_PTYS=y
CONFIG_KEYS=y

# === Cmdline ===
CONFIG_CMDLINE_BOOL=y
CONFIG_CMDLINE="console=ttyS0 rw root=host9p rootfstype=9p rootflags=trans=virtio,cache=loose mitigations=off audit=0 tsc=reliable random.trust_cpu=on nowatchdog noapic nomce"

# === Optimize ===
CONFIG_EXPERT=y
CONFIG_CC_OPTIMIZE_FOR_SIZE=y
CONFIG_INIT_ON_FREE_DEFAULT_ON=y
CONFIG_CPU_FREQ_DEFAULT_GOV_PERFORMANCE=y

# === Explicitly disable major subsystems ===
# CONFIG_MODULES is not set
# CONFIG_SECURITY is not set
# CONFIG_SECCOMP is not set
# CONFIG_CGROUPS is not set
# CONFIG_NAMESPACES is not set
# CONFIG_BPF is not set
# CONFIG_PERF_EVENTS is not set
# CONFIG_USB_SUPPORT is not set
# CONFIG_WIRELESS is not set
# CONFIG_WLAN is not set
# CONFIG_CFG80211 is not set
# CONFIG_BT is not set
# CONFIG_RFKILL is not set
# CONFIG_SOUND is not set
# CONFIG_DRM is not set
# CONFIG_AGP is not set
# CONFIG_MEDIA_SUPPORT is not set
# CONFIG_ATA is not set
# CONFIG_SCSI is not set
# CONFIG_MD is not set
# CONFIG_HWMON is not set
# CONFIG_THERMAL is not set
# CONFIG_WATCHDOG is not set
# CONFIG_VIRTUALIZATION is not set
# CONFIG_DEBUG_KERNEL is not set
# CONFIG_PROFILING is not set
# CONFIG_KPROBES is not set
# CONFIG_AUDIT is not set
# CONFIG_CRASH_DUMP is not set
# CONFIG_KEXEC is not set
# CONFIG_RANDOMIZE_BASE is not set
# CONFIG_RETPOLINE is not set
# CONFIG_GCC_PLUGINS is not set
# CONFIG_ZRAM is not set
# CONFIG_ZSWAP is not set
# CONFIG_SWAP is not set
# CONFIG_DMADEVICES is not set
# CONFIG_I2C is not set
# CONFIG_NEW_LEDS is not set
# CONFIG_PCCARD is not set
# CONFIG_TASKSTATS is not set
# CONFIG_POSIX_MQUEUE is not set
# CONFIG_LEGACY_PTYS is not set
# CONFIG_SPECULATION_MITIGATIONS is not set
# CONFIG_STACKPROTECTOR is not set
```
