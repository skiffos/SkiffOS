## configs/driver/vboxmodules/buildroot_ext/Config.in
```kconfig
source "$BR2_EXTERNAL_DRIVER_VBOXMODULES_PATH/package/virtualbox-modules/Config.in"
```

## configs/driver/vboxmodules/buildroot_ext/package/virtualbox-modules/Config.in
```kconfig
config BR2_PACKAGE_VIRTUALBOX_MODULES
	bool "virtualbox-modules"
	depends on BR2_LINUX_KERNEL
	help
	  VirtualBox host kernel modules.

	  https://www.virtualbox.org/

comment "virtualbox-modules needs a Linux kernel to be built"
	depends on !BR2_LINUX_KERNEL
```

## configs/driver/wl/buildroot_ext/package/broadcom-sta/Config.in
```kconfig
config BR2_PACKAGE_BROADCOM_STA
	bool "broadcom-sta"
	depends on BR2_LINUX_KERNEL
	help
	  Broadcom-sta is the wl kernel module for Broadcom wireless cards.

	  https://github.com/antoineco/broadcom-wl

comment "broadcom-sta needs a Linux kernel to be built"
	depends on !BR2_LINUX_KERNEL
```

## configs/jetson/common/buildroot_ext/Config.in
```kconfig
source "$BR2_EXTERNAL_JETSON_COMMON_PATH/package/linux4tegra/Config.in"
source "$BR2_EXTERNAL_JETSON_COMMON_PATH/package/linux4tegra-legacy/Config.in"
source "$BR2_EXTERNAL_JETSON_COMMON_PATH/package/skiff-core-linux4tegra/Config.in"
source "$BR2_EXTERNAL_JETSON_COMMON_PATH/package/skiff-core-linux4tegra-legacy/Config.in"
```

## configs/jetson/common/buildroot_ext/package/linux4tegra-legacy/Config.in
```kconfig
config BR2_PACKAGE_LINUX4TEGRA_LEGACY_LEGACY
	help
	  Supports discontinued boards: Jetson TX2, Nano.

	  https://developer.nvidia.com/embedded/linux-tegra-archive

if BR2_PACKAGE_LINUX4TEGRA_LEGACY

choice
	prompt "Platform"
	default BR2_PACKAGE_LINUX4TEGRA_LEGACY_PLATFORM_T186REF
	help
	  Select the platform variant for linux4tegra-legacy.

config BR2_PACKAGE_LINUX4TEGRA_LEGACY_PLATFORM_T186REF
	bool "t186ref"
	help
	  Jetson TX2

config BR2_PACKAGE_LINUX4TEGRA_LEGACY_PLATFORM_T210REF
	bool "t210ref"
	help
	  Jetson Nano or Jetson TX1

endchoice

endif # if BR2_PACKAGE_LINUX4TEGRA_LEGACY
```

## configs/jetson/common/buildroot_ext/package/linux4tegra-xusb/Config.in
```kconfig
config BR2_PACKAGE_LINUX4TEGRA_XUSB
	bool "linux4tegra-xusb"
	select BR2_PACKAGE_LINUX4TEGRA
	help
	  NVIDIA Linux4Tegra XUSB firmware binaries overlay.

	  Supports Jetson AGX series boards.

	  https://developer.nvidia.com/embedded/linux-tegra-archive
```

## configs/jetson/common/buildroot_ext/package/linux4tegra/Config.in
```kconfig
config BR2_PACKAGE_LINUX4TEGRA
	bool "linux4tegra"
	help
	  NVIDIA Linux4Tegra utilities and binaries.

	  Supports Jetson AGX series boards.

	  https://developer.nvidia.com/embedded/linux-tegra-archive
```

## configs/jetson/common/buildroot_ext/package/skiff-core-linux4tegra-legacy/Config.in
```kconfig
config BR2_PACKAGE_SKIFF_CORE_LINUX4TEGRA_LEGACY
	bool "skiff-core-linux4tegra-legacy"
	depends on BR2_PACKAGE_HOST_GO_TARGET_ARCH_SUPPORTS
	depends on BR2_PACKAGE_HOST_GO_TARGET_CGO_LINKING_SUPPORTS
	depends on BR2_TOOLCHAIN_HAS_THREADS
	depends on !BR2_TOOLCHAIN_USES_UCLIBC # docker-containerd -> runc
	depends on BR2_USE_MMU # docker-containerd
	select BR2_PACKAGE_SKIFF_CORE
	select BR2_PACKAGE_SKIFF_CORE_DEFCONFIG
	help
	  Skiff Core environment defconfig for NVIDIA Jetson.

	  https://github.com/skiffos/skiff-core
```

## configs/jetson/common/buildroot_ext/package/skiff-core-linux4tegra/Config.in
```kconfig
config BR2_PACKAGE_SKIFF_CORE_LINUX4TEGRA
	bool "skiff-core-linux4tegra"
	depends on BR2_PACKAGE_HOST_GO_TARGET_ARCH_SUPPORTS
	depends on BR2_PACKAGE_HOST_GO_TARGET_CGO_LINKING_SUPPORTS
	depends on BR2_TOOLCHAIN_HAS_THREADS
	depends on !BR2_TOOLCHAIN_USES_UCLIBC # docker-containerd -> runc
	depends on BR2_USE_MMU # docker-containerd
	select BR2_PACKAGE_SKIFF_CORE
	select BR2_PACKAGE_SKIFF_CORE_DEFCONFIG
	help
	  Skiff Core environment defconfig for NVIDIA Jetson.

	  https://github.com/skiffos/skiff-core

comment "skiff-core-linux4tegra needs a glibc toolchain w/ threads"
	depends on BR2_PACKAGE_HOST_GO_TARGET_ARCH_SUPPORTS
	depends on BR2_PACKAGE_HOST_GO_TARGET_CGO_LINKING_SUPPORTS
	depends on !BR2_TOOLCHAIN_HAS_THREADS || !BR2_TOOLCHAIN_USES_GLIBC
```

## configs/modalai/voxl2/buildroot_ext/package/skiff-core-voxl2/Config.in
```kconfig
config BR2_PACKAGE_SKIFF_CORE_VOXL2
	bool "skiff-core-voxl2"
	select BR2_PACKAGE_SKIFF_CORE
	select BR2_PACKAGE_SKIFF_CORE_DEFCONFIG
	help
	  Skiff Core environment defconfig for Voxl2.

	  https://gitlab.com/voxl-public/support/documentation
```

## configs/nvidia/tegra/buildroot_ext/Config.in
```kconfig
source "$BR2_EXTERNAL_NVIDIA_TEGRA_PATH/package/skiff-core-linux4tegra/Config.in"
```

## configs/nvidia/tegra/buildroot_ext/package/libnvidia-container/Config.in
```kconfig
config BR2_PACKAGE_LIBNVIDIA_CONTAINER
	bool "libnvidia-container"
	depends on BR2_SHARED_LIBS
	depends on BR2_TOOLCHAIN_HAS_THREADS # tirpc
	depends on BR2_TOOLCHAIN_USES_GLIBC # fexecve
	select BR2_PACKAGE_ELFUTILS
	select BR2_PACKAGE_LIBCAP
	select BR2_PACKAGE_LIBTIRPC
	select BR2_PACKAGE_NVIDIA_MODPROBE
	help
	  The libnvidia-container package adds a library and CLI for
	  GPU-backed containers, agnostic to container runtime.

	  https://github.com/NVIDIA/libnvidia-container

comment "libnvidia-container needs a shared glibc toolchain w/ threads"
	depends on !BR2_TOOLCHAIN_HAS_THREADS || !BR2_TOOLCHAN_USES_GLIBC || \
		!BR2_SHARED_LIBS
```

## configs/nvidia/tegra/buildroot_ext/package/linux4tegra/Config.in
```kconfig
config BR2_PACKAGE_LINUX4TEGRA
	bool "linux4tegra"
	help
	  NVIDIA Linux4Tegra utilities and binaries.

	  https://developer.nvidia.com/embedded/linux-tegra-archive
```

## configs/nvidia/tegra/buildroot_ext/package/nvidia-container-runtime/Config.in
```kconfig
config BR2_PACKAGE_NVIDIA_CONTAINER_RUNTIME
	bool "nvidia-container-runtime"
	depends on BR2_PACKAGE_HOST_GO_TARGET_ARCH_SUPPORTS
	depends on BR2_PACKAGE_HOST_GO_TARGET_CGO_LINKING_SUPPORTS
	depends on BR2_TOOLCHAIN_HAS_THREADS
	depends on BR2_TOOLCHAIN_USES_GLIBC # fexecve
	help
	  NVIDIA Container Runtime is a fork of runc which adds
	  support for mounting GPUs into containers.

	  https://github.com/NVIDIA/nvidia-container-runtime

comment "nvidia-container-runtime needs a glibc toolchain w/ threads"
	depends on BR2_PACKAGE_HOST_GO_TARGET_ARCH_SUPPORTS && \
		BR2_PACKAGE_HOST_GO_TARGET_CGO_LINKING_SUPPORTS
	depends on !BR2_TOOLCHAIN_HAS_THREADS || !BR2_TOOLCHAN_USES_GLIBC
```

## configs/nvidia/tegra/buildroot_ext/package/nvidia-container-toolkit/Config.in
```kconfig
config BR2_PACKAGE_NVIDIA_CONTAINER_TOOLKIT
	bool "nvidia-container-toolkit"
	depends on BR2_PACKAGE_HOST_GO_TARGET_ARCH_SUPPORTS
	depends on BR2_PACKAGE_HOST_GO_TARGET_CGO_LINKING_SUPPORTS
	depends on BR2_TOOLCHAIN_HAS_THREADS
	depends on BR2_TOOLCHAIN_USES_GLIBC # fexecve
	select BR2_PACKAGE_LIBNVIDIA_CONTAINER
	select BR2_PACKAGE_NVIDIA_CONTAINER_RUNTIME
	help
	  NVIDIA Container Toolkit is a OCI-spec hook for
	  support for mounting GPUs into containers.

	  https://github.com/NVIDIA/nvidia-container-toolkit

comment "nvidia-container-toolkit needs a glibc toolchain w/ threads"
	depends on BR2_PACKAGE_HOST_GO_TARGET_ARCH_SUPPORTS && \
		BR2_PACKAGE_HOST_GO_TARGET_CGO_LINKING_SUPPORTS
	depends on !BR2_TOOLCHAIN_HAS_THREADS || !BR2_TOOLCHAN_USES_GLIBC
```

## configs/nvidia/tegra/buildroot_ext/package/nvidia-modprobe/Config.in
```kconfig
config BR2_PACKAGE_NVIDIA_MODPROBE
	bool "nvidia-modprobe"
	depends on BR2_TOOLCHAIN_HAS_THREADS
	depends on BR2_TOOLCHAIN_USES_GLIBC
	help
	  nvidia-modprobe package adds a utility and headers for
	  probing the NVIDIA hardware at runtime.

	  https://github.com/NVIDIA/nvidia-modprobe

comment "nvidia-modprobe needs a glibc toolchain w/ threads"
	depends on !BR2_TOOLCHAIN_HAS_THREADS || !BR2_TOOLCHAN_USES_GLIBC
```

## configs/odroid/c2/buildroot_ext/package/odroidc2-uboot-blobs/Config.in
```kconfig
config BR2_PACKAGE_ODROIDC2_UBOOT_BLOBS
	bool "odroidc2-uboot-blobs"
	help
	  Odroid c2 closed-source u-boot blobs.

	  https://gitlab.com/armbian/odroidc2-blobs
```

## configs/odroid/c4/buildroot_ext/package/amlogic-boot-fip/Config.in
```kconfig
config BR2_PACKAGE_AMLOGIC_BOOT_FIP
	bool "amlogic-boot-fip"
	help
	  Amlogic boot fip blobs.

	  https://gitlab.com/LibreELEC/amlogic-boot-fip
```

## configs/odroid/common/buildroot_ext/Config.in
```kconfig
source "$BR2_EXTERNAL_ODROID_COMMON_PATH/package/odroidm1-uboot-blobs/Config.in"
source "$BR2_EXTERNAL_ODROID_COMMON_PATH/package/odroidn2-uboot-blobs/Config.in"
source "$BR2_EXTERNAL_ODROID_COMMON_PATH/package/odroidxu-uboot-blobs/Config.in"
source "$BR2_EXTERNAL_ODROID_COMMON_PATH/package/rkbin-firmware/Config.in"
```

## configs/odroid/common/buildroot_ext/package/amlogic-boot-fip/Config.in
```kconfig
config BR2_PACKAGE_AMLOGIC_BOOT_FIP
	bool "amlogic-boot-fip"
	help
	  Amlogic boot fip blobs.

	  https://gitlab.com/LibreELEC/amlogic-boot-fip

if BR2_PACKAGE_AMLOGIC_BOOT_FIP

config BR2_PACKAGE_AMLOGIC_BOOT_FIP_BOARD
	string "amlogic-boot-fip board name"
	default "odroid-n2-plus"
	help
	  Board and subdirectory name in amlogic-boot-fip.

endif # BR2_PACKAGE_AMLOGIC_BOOT_FIP
```

## configs/odroid/common/buildroot_ext/package/odroidm1-uboot-blobs/Config.in
```kconfig
config BR2_PACKAGE_ODROIDM1_UBOOT_BLOBS
	bool "odroidm1-uboot-blobs"
	help
	  Pre-compiled u-boot for odroid m1.

	  https://github.com/skiffos/odroidm1-uboot-blobs
```
