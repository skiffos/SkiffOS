## configs/core/fedora/buildroot_ext/package/skiff-core-fedora/Config.in
```kconfig
# armv7 support for Fedora was removed as of Fedora 37.
# riscv support is not yet available.
config BR2_PACKAGE_SKIFF_CORE_FEDORA_SUPPORTS
	bool
	default y if BR2_RISCV_64
	default y if BR2_aarch64
	default y if BR2_i386
	default y if BR2_x86_64

config BR2_PACKAGE_SKIFF_CORE_FEDORA
	bool "skiff-core-fedora"
	depends on BR2_PACKAGE_HOST_GO_TARGET_ARCH_SUPPORTS
	depends on BR2_PACKAGE_HOST_GO_TARGET_CGO_LINKING_SUPPORTS
	depends on BR2_TOOLCHAIN_HAS_THREADS
	depends on !BR2_TOOLCHAIN_USES_UCLIBC # docker-containerd -> runc
	depends on BR2_USE_MMU # docker-containerd
	select BR2_PACKAGE_SKIFF_CORE
	select BR2_PACKAGE_SKIFF_CORE_DEFCONFIG
	help
	  Skiff Core environment for Fedora.
```

## configs/core/holoiso/buildroot_ext/package/skiff-core-holoiso/Config.in
```kconfig
config BR2_PACKAGE_SKIFF_CORE_HOLOISO
	bool "skiff-core-holoiso"
	select BR2_PACKAGE_SKIFF_CORE
	select BR2_PACKAGE_SKIFF_CORE_DEFCONFIG
	help
	  Skiff Core environment with Holoiso for Steam Deck.

	  https://github.com/theVakhovskeIsTaken/holoiso
```

## configs/core/libreelec/buildroot_ext/Config.in
```kconfig
source "$BR2_EXTERNAL_CORE_LIBREELEC_PATH/package/skiff-core-libreelec/Config.in"
```

## configs/core/nasa_cfs/buildroot_ext/package/skiff-core-nasa-cfs/Config.in
```kconfig
config BR2_PACKAGE_SKIFF_CORE_NASA_CFS
	bool "skiff-core-nasa-cfs"
	depends on BR2_PACKAGE_HOST_GO_TARGET_ARCH_SUPPORTS
	depends on BR2_PACKAGE_HOST_GO_TARGET_CGO_LINKING_SUPPORTS
	depends on BR2_TOOLCHAIN_HAS_THREADS
	depends on !BR2_TOOLCHAIN_USES_UCLIBC # docker-containerd -> runc
	depends on BR2_USE_MMU # docker-containerd
	select BR2_PACKAGE_DOCKER_ENGINE # skiff-core
	select BR2_PACKAGE_DOCKER_CONTAINERD # skiff-core
	select BR2_PACKAGE_DOCKER_PROXY # skiff-core
	select BR2_PACKAGE_IPTABLES # skiff-core
	select BR2_PACKAGE_SQLITE # skiff-core
	select BR2_PACKAGE_SKIFF_CORE
	select BR2_PACKAGE_SKIFF_CORE_DEFCONFIG
	help
	  Skiff Core environment for hosting Core Flight System.

	  https://github.com/nasa/cfs
```

## configs/core/nasa_fprime/buildroot_ext/package/skiff-core-nasa-fprime/Config.in
```kconfig
config BR2_PACKAGE_SKIFF_CORE_NASA_FPRIME
	bool "skiff-core-nasa-fprime"
	depends on BR2_PACKAGE_HOST_GO_TARGET_ARCH_SUPPORTS
	depends on BR2_PACKAGE_HOST_GO_TARGET_CGO_LINKING_SUPPORTS
	depends on BR2_TOOLCHAIN_HAS_THREADS
	depends on !BR2_TOOLCHAIN_USES_UCLIBC # docker-containerd -> runc
	depends on BR2_USE_MMU # docker-containerd
	select BR2_PACKAGE_DOCKER_ENGINE # skiff-core
	select BR2_PACKAGE_DOCKER_CONTAINERD # skiff-core
	select BR2_PACKAGE_DOCKER_PROXY # skiff-core
	select BR2_PACKAGE_IPTABLES # skiff-core
	select BR2_PACKAGE_SQLITE # skiff-core
	select BR2_PACKAGE_SKIFF_CORE
	select BR2_PACKAGE_SKIFF_CORE_DEFCONFIG
	help
	  Skiff Core environment for hosting NASA Fprime framework.

	  https://github.com/nasa/fprime
```

## configs/core/nixos_xfce/buildroot_ext/Config.in
```kconfig
source "$BR2_EXTERNAL_CORE_NIXOS_XFCE_PATH/package/skiff-core-nixos-xfce/Config.in"
```

## configs/core/pinebook_gentoo/buildroot_ext/Config.in
```kconfig
source "$BR2_EXTERNAL_CORE_PINEBOOK_GENTOO_PATH/package/skiff-core-pinebook-gentoo/Config.in"
```

## configs/core/pinebook_gentoo/buildroot_ext/package/skiff-core-pinebook-gentoo/Config.in
```kconfig
config BR2_PACKAGE_SKIFF_CORE_PINEBOOK_GENTOO
	bool "skiff-core-pinebook-gentoo"
	depends on BR2_PACKAGE_HOST_GO_TARGET_ARCH_SUPPORTS
	depends on BR2_PACKAGE_HOST_GO_TARGET_CGO_LINKING_SUPPORTS
	depends on BR2_TOOLCHAIN_HAS_THREADS
	depends on !BR2_TOOLCHAIN_USES_UCLIBC # docker-containerd -> runc
	depends on BR2_USE_MMU # docker-containerd
	select BR2_PACKAGE_DOCKER_ENGINE # skiff-core
	select BR2_PACKAGE_DOCKER_CONTAINERD # skiff-core
	select BR2_PACKAGE_DOCKER_PROXY # skiff-core
	select BR2_PACKAGE_IPTABLES # skiff-core
	select BR2_PACKAGE_SQLITE # skiff-core
	select BR2_PACKAGE_SKIFF_CORE
	select BR2_PACKAGE_SKIFF_CORE_GENTOO
	help
	  Skiff Core optimized for Pinebook with KDE and GentooLTO.

comment "skiff-core-pinebook-gentoo needs a glibc toolchain w/ threads"
	depends on BR2_PACKAGE_HOST_GO_TARGET_ARCH_SUPPORTS
	depends on BR2_PACKAGE_HOST_GO_TARGET_CGO_LINKING_SUPPORTS
	depends on !BR2_TOOLCHAIN_HAS_THREADS || !BR2_TOOLCHAIN_USES_GLIBC
```

## configs/core/pinebook_manjaro_kde/buildroot_ext/Config.in
```kconfig
source "$BR2_EXTERNAL_CORE_PINEBOOK_MANJARO_KDE_PATH/package/skiff-core-pinebook-manjaro-kde/Config.in"
```

## configs/core/pinebook_manjaro_kde/buildroot_ext/package/skiff-core-pinebook-manjaro-kde/Config.in
```kconfig
config BR2_PACKAGE_SKIFF_CORE_PINEBOOK_MANJARO_KDE
	bool "skiff-core-pinebook-manjaro-kde"
	depends on BR2_PACKAGE_HOST_GO_TARGET_ARCH_SUPPORTS
	depends on BR2_PACKAGE_HOST_GO_TARGET_CGO_LINKING_SUPPORTS
	depends on BR2_TOOLCHAIN_HAS_THREADS
	depends on !BR2_TOOLCHAIN_USES_UCLIBC # docker-containerd -> runc
	depends on BR2_USE_MMU # docker-containerd
	select BR2_PACKAGE_SKIFF_CORE
	select BR2_PACKAGE_SKIFF_CORE_DEFCONFIG
	help
	  Skiff Core environment with PineBook Manjaro KDE.

	  https://manjaro.org

comment "skiff-core-pinebook-manjaro-kde needs a glibc toolchain w/ threads"
	depends on BR2_PACKAGE_HOST_GO_TARGET_ARCH_SUPPORTS
	depends on BR2_PACKAGE_HOST_GO_TARGET_CGO_LINKING_SUPPORTS
	depends on !BR2_TOOLCHAIN_HAS_THREADS || !BR2_TOOLCHAIN_USES_GLIBC
```

## configs/core/pinephone_manjaro_kde/buildroot_ext/Config.in
```kconfig
source "$BR2_EXTERNAL_CORE_PINEPHONE_MANJARO_KDE_PATH/package/skiff-core-pinephone-manjaro-kde/Config.in"
```

## configs/core/pinephone_manjaro_phosh/buildroot_ext/Config.in
```kconfig
source "$BR2_EXTERNAL_CORE_PINEPHONE_MANJARO_PHOSH_PATH/package/skiff-core-pinephone-manjaro-phosh/Config.in"
```

## configs/core/pinephone_neon/buildroot_ext/Config.in
```kconfig
source "$BR2_EXTERNAL_CORE_PINEPHONE_NEON_PATH/package/skiff-core-pinephone-neon/Config.in"
```

## configs/core/pinephone_nixos/buildroot_ext/Config.in
```kconfig
source "$BR2_EXTERNAL_CORE_PINEPHONE_NIXOS_PATH/package/skiff-core-pinephone-nixos/Config.in"
```

## configs/core/pinephone_nixos/buildroot_ext/package/skiff-core-pinephone-nixos/Config.in
```kconfig
config BR2_PACKAGE_SKIFF_CORE_PINEPHONE_NIXOS
	bool "skiff-core-pinephone-nixos"
	depends on BR2_PACKAGE_HOST_GO_TARGET_ARCH_SUPPORTS
	depends on BR2_PACKAGE_HOST_GO_TARGET_CGO_LINKING_SUPPORTS
	depends on BR2_TOOLCHAIN_HAS_THREADS
	depends on !BR2_TOOLCHAIN_USES_UCLIBC # docker-containerd -> runc
	depends on BR2_USE_MMU # docker-containerd
	select BR2_PACKAGE_SKIFF_CORE
	select BR2_PACKAGE_SKIFF_CORE_NIXOS
	help
	  Skiff Core environment defconfig with PinePhone NixOS.

	  https://github.com/skiffos/skiff-core

comment "skiff-core-pinephone-nixos needs a glibc toolchain w/ threads"
	depends on BR2_PACKAGE_HOST_GO_TARGET_ARCH_SUPPORTS
	depends on BR2_PACKAGE_HOST_GO_TARGET_CGO_LINKING_SUPPORTS
	depends on !BR2_TOOLCHAIN_HAS_THREADS || !BR2_TOOLCHAIN_USES_GLIBC
```

## configs/core/pinephone_ubports/buildroot_ext/Config.in
```kconfig
source "$BR2_EXTERNAL_CORE_PINEPHONE_UBPORTS_PATH/package/skiff-core-ubports/Config.in"
```

## configs/core/pinephone_ubtouch/buildroot_ext/Config.in
```kconfig
source "$BR2_EXTERNAL_CORE_PINEPHONE_UBTOUCH_PATH/package/skiff-core-pinephone-ubtouch/Config.in"
```
