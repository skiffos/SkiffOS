## configs/virt/virtualbox/buildroot_ext/package/virtualbox-guest/Config.in
```kconfig
config BR2_PACKAGE_VIRTUALBOX_GUEST
	bool "virtualbox-guest"
	depends on BR2_LINUX_KERNEL
	help
	  VirtualBox guest kernel modules.

	  https://www.virtualbox.org/

comment "virtualbox-guest needs a Linux kernel to be built"
	depends on !BR2_LINUX_KERNEL
```

## configs/virt/wsl/buildroot_ext/Config.in
```kconfig
source "$BR2_EXTERNAL_VIRT_WSL_PATH/package/wsl-shell/Config.in"
source "$BR2_EXTERNAL_VIRT_WSL_PATH/package/wslu/Config.in"
```

## configs/virt/wsl/buildroot_ext/package/wsl-shell/Config.in
```kconfig
config BR2_PACKAGE_WSL_SHELL
	bool "wsl-shell"
	depends on BR2_TOOLCHAIN_HAS_THREADS
	depends on !BR2_TOOLCHAIN_USES_UCLIBC
	help
	  Statically linked shell binary to chroot into squashfs.

if BR2_PACKAGE_WSL_SHELL

config BR2_PACKAGE_WSL_SHELL_CHROOT_TARGET
	bool "chroot into target fs"
	default y
	help
	  chroots into the mountpoint before running the shell

config BR2_PACKAGE_WSL_SHELL_RUN_SKIFF_INIT
	bool "start skiff-init if not running"
	default y
	help
	  attempts to start skiff-init if not running

config BR2_PACKAGE_WSL_SHELL_NO_DROP_ENV
	bool "disable dropping parent env for shell"
	help
	  keeps the parent environment in the shell

endif # BR2_PACKAGE_WSL_SHELL
```

## configs/virt/wsl/buildroot_ext/package/wslu/Config.in
```kconfig
config BR2_PACKAGE_WSLU
	bool "wslu"
	help
	  WSL guest utilities.

	  https://github.com/wslutilities/wslu
```
