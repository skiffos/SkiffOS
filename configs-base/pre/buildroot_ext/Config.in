## configs-base/pre/buildroot_ext/Config.in
```kconfig
source "$BR2_EXTERNAL_SKIFFOS_PATH/package/static-busybox/Config.in"
source "$BR2_EXTERNAL_SKIFFOS_PATH/package/static-kexec/Config.in"
source "$BR2_EXTERNAL_SKIFFOS_PATH/package/skiff-init-kexec/Config.in"
source "$BR2_EXTERNAL_SKIFFOS_PATH/package/skiff-init-resize2fs/Config.in"
source "$BR2_EXTERNAL_SKIFFOS_PATH/package/skiff-init-squashfs/Config.in"
```

## configs-base/pre/buildroot_ext/package/skiff-init-busybox/Config.in
```kconfig
# based on BR2_SKIFF_INIT_BUSYBOX
# compiles busybox as static binary

menuconfig BR2_PACKAGE_SKIFF_INIT_BUSYBOX
	bool "skiff-init-busybox"
	help
	  Build static busybox binary and copy to images dir (for target).
```

## configs-base/pre/buildroot_ext/package/skiff-init-kexec/Config.in
```kconfig
config BR2_PACKAGE_SKIFF_INIT_KEXEC
	bool "skiff-init-kexec"
	depends on BR2_TOOLCHAIN_HAS_THREADS
	depends on !BR2_TOOLCHAIN_USES_UCLIBC
	depends on BR2_USE_MMU
	select BR2_PACKAGE_STATIC_KEXEC
	help
	  Statically linked init binary to kexec the system.

if BR2_PACKAGE_SKIFF_INIT_KEXEC

config BR2_PACKAGE_SKIFF_INIT_KEXEC_PATH
	string "path to static kexec"
	default "/boot/skiff-init/kexec"
	help
	  Path to the kexec binary to run.

config BR2_PACKAGE_SKIFF_INIT_KEXEC_KERNEL
	string "path to the kernel image"
	default "/boot/Image"
	help
	  Path to load as the new kernel Image.

config BR2_PACKAGE_SKIFF_INIT_KEXEC_CMDLINE
	string "cmdline for the kernel"
	help
	  Set the command line args for the new kernel.

config BR2_PACKAGE_SKIFF_INIT_KEXEC_CMDLINE_APPEND
	bool "append to cmdline"
  default y
	help
	  Append to the command line instead of override.

config BR2_PACKAGE_SKIFF_INIT_KEXEC_CMDLINE_REUSE
	bool "reuse cmdline from previous kernel"
	default y
	help
	  Reuse the command line from the existing kernel.

config BR2_PACKAGE_SKIFF_INIT_KEXEC_INITRD
	string "initrd for the kernel"
	help
	  Path to load as the new kernel initramfs.
	  
	  example: /boot/rootfs.cpio

endif # BR2_PACKAGE_SKIFF_INIT_KEXEC
```

## configs-base/pre/buildroot_ext/package/skiff-init-resize2fs/Config.in
```kconfig
# based on BR2_PACKAGE_E2FSPROGS
# compiles resize2fs as static binary

menuconfig BR2_PACKAGE_SKIFF_INIT_RESIZE2FS
	bool "skiff-init-resize2fs"
	depends on BR2_USE_MMU # util-linux/libblkid
	help
	  Build resize2fs static binary and copy to images dir (for target).

	  http://e2fsprogs.sourceforge.net
```

## configs-base/pre/buildroot_ext/package/skiff-init-squashfs/Config.in
```kconfig
config BR2_PACKAGE_SKIFF_INIT_SQUASHFS
	bool "skiff-init-squashfs"
	depends on BR2_TOOLCHAIN_HAS_THREADS
	depends on !BR2_TOOLCHAIN_USES_UCLIBC
	depends on BR2_USE_MMU
	help
	  Statically linked init binary to chroot into squashfs.

if BR2_PACKAGE_SKIFF_INIT_SQUASHFS

config BR2_PACKAGE_SKIFF_INIT_SQUASHFS_BIND_ROOT_MNT
	bool "inherit /mnt from the root fs"
	help
	  Bind mounts /mnt into the chroot system at /mnt

config BR2_PACKAGE_SKIFF_INIT_SQUASHFS_BIND_HOST_PATHS
	string "list of host bind mounts"
	help
	  space separated list of /source-path:/target-path pairs

config BR2_PACKAGE_SKIFF_INIT_SQUASHFS_CHROOT_TARGET
	bool "chroot into target fs"
	default y
	help
	  chroots into the mountpoint before running init.

config BR2_PACKAGE_SKIFF_INIT_SQUASHFS_INIT_PROC
	string "init process to run"
	default "/lib/systemd/systemd"

config BR2_PACKAGE_SKIFF_INIT_SQUASHFS_PATH
	string "override the path to the rootfs squashfs"
	help
	  Overrides the default /boot/rootfs.squashfs

config BR2_PACKAGE_SKIFF_INIT_SQUASHFS_WAIT_EXISTS
	string "wait for a path to exist"
	help
	  Waits for the given path to exist before starting.

config BR2_PACKAGE_SKIFF_INIT_SQUASHFS_MOUNT_BOOT
	string "mount /mnt/boot with device or path"
	help
	  Mounts the given device at /mnt/boot if set.

config BR2_PACKAGE_SKIFF_INIT_SQUASHFS_MOUNT_BOOT_BIND
	bool "mount /mnt/boot with a bind mount"
	help
	  Mounts the MOUNT_BOOT option as a bind mount.

config BR2_PACKAGE_SKIFF_INIT_SQUASHFS_MOUNT_BOOT_FSTYPE
	string "set the fstype for the /mnt/boot mount"
	help
	  Overrides the default value of vfat for /mnt/boot

config BR2_PACKAGE_SKIFF_INIT_SQUASHFS_MOUNT_PROC
	bool "mount /proc in the target fs"
	default y
	help
	  Mounts /proc into the chroot system at /proc

config BR2_PACKAGE_SKIFF_INIT_SQUASHFS_MOUNT_SYS
	bool "mount /sys in the target fs"
	default y
	help
	  Mounts /proc into the chroot system at /proc

config BR2_PACKAGE_SKIFF_INIT_SQUASHFS_MOUNT_SYS_RBIND
	bool "mount /sys in the target fs as rbind"
	select BR2_PACKAGE_SKIFF_INIT_SQUASHFS_MOUNT_SYS
	help
	  Mounts /sys into the chroot system at /sys with rbind

config BR2_PACKAGE_SKIFF_INIT_SQUASHFS_NO_MOVE_MOUNTPOINT_ROOT
	bool "disable moving mountpoint to /"
	help
	  Disable moving skiff mountpoint to /

config BR2_PACKAGE_SKIFF_INIT_SQUASHFS_RESIZE2FS
	bool "resize filesystems with resize2fs"
	select BR2_PACKAGE_SKIFF_INIT_RESIZE2FS # resize2fs
	select BR2_PACKAGE_UTIL_LINUX
	select BR2_PACKAGE_UTIL_LINUX_BINARIES # fdisk, sfdisk
	help
	  Run resize2fs on disks defined in resize2fs.conf
    
config BR2_PACKAGE_SKIFF_INIT_SQUASHFS_ROOT_AS_PERSIST
	bool "inherit / to /mnt/persist from the root fs"
	default y
	help
	  Mounts / into the chroot system at /mnt/persist

config BR2_PACKAGE_SKIFF_INIT_SQUASHFS_ROOT_AS_BOOT
	depends on !BR2_PACKAGE_SKIFF_INIT_SQUASHFS_BIND_ROOT_MNT
	bool "inherit /mnt/boot from root fs to /mnt/boot in chroot"
	help
	  Mounts /mnt/boot into the chroot system at /mnt/boot

config BR2_PACKAGE_SKIFF_INIT_SQUASHFS_ROOT_MAKE_SHARED
	bool "ensure that the / mount is shared"
	help
	  Ensures that / is a shared mount on startup.

config BR2_PACKAGE_SKIFF_INIT_SQUASHFS_MUTABLE_OVERLAY_SIZE
	string "set the upper limit for the / tmpfs"
	help
	  Sets the upper limit for the / tmpfs size.
	  
	  Default: 1G, can specify as a % of RAM: e.x. 50%.

config BR2_PACKAGE_SKIFF_INIT_SQUASHFS_WRITE_SKIFF_INIT_PID
	bool "write skiff-init pid file"
	help
	  write PID file for systemd to /run/skiff-init/skiff-init.pid

endif # BR2_PACKAGE_SKIFF_INIT_SQUASHFS
```

## configs-base/pre/buildroot_ext/package/skiff-sdcard/Config.in
```kconfig
config BR2_PACKAGE_SKIFF_SDCARD
	bool "skiff-sdcard"
	help
	  Standard boot media format/install scripts.

if BR2_PACKAGE_SKIFF_SDCARD

config BR2_PACKAGE_SKIFF_SDCARD_SINGLE_PARTITION
	bool "use a single persist partition"
	help
	  TODO use a single persist partition.
	
	  Most configs also set PERSIST_LABEL.
	  mounts rbind /boot as /mnt/boot and
	  / to /mnt/persist.

config BR2_PACKAGE_SKIFF_SDCARD_BOOT_LABEL
	string "label of boot partition"
	default "boot"
	help
	  the label of the boot partition to use.

config BR2_PACKAGE_SKIFF_SDCARD_ROOTFS_LABEL
	string "label of rootfs (resources) partition"
	default "rootfs"
	help
	  the label of the rootfs partition to use.
		
	  contains modules.squashfs and other resources.

config BR2_PACKAGE_SKIFF_SDCARD_PERSIST_LABEL
	string "label of persist partition"
	default "persist"
	help
	  the label of the persist partition to use.

endif # BR2_PACKAGE_SKIFF_SDCARD
```

## configs-base/pre/buildroot_ext/package/static-busybox/Config.in
```kconfig
# based on BR2_STATIC_BUSYBOX
# compiles busybox as static binary

menuconfig BR2_PACKAGE_STATIC_BUSYBOX
	bool "static-busybox"
	help
	  Build static busybox binary and copy to images dir (for target).
```

## configs/apple/macbook/buildroot_ext/Config.in
```kconfig
source "$BR2_EXTERNAL_APPLE_MACBOOK_PATH/package/facetimehd/Config.in"
source "$BR2_EXTERNAL_APPLE_MACBOOK_PATH/package/facetimehd-firmware/Config.in"
```

## configs/apple/macbook/buildroot_ext/package/facetimehd-firmware/Config.in
```kconfig
config BR2_PACKAGE_FACETIMEHD_FIRMWARE
	bool "facetimehd-firmware"
	help
	  This package provides binary firmware files (closed blobs)
	  for the facetime HD camera.

	  https://github.com/patjak/facetimehd-firmware
```

## configs/apple/macbook/buildroot_ext/package/facetimehd/Config.in
```kconfig
config BR2_PACKAGE_FACETIMEHD
	bool "facetimehd"
	help
	  camera driver for MacBook laptops

	  https://github.com/patjak/facetimehd
```

## configs/apple/macbook/buildroot_ext/package/mbpfan/Config.in
```kconfig
config BR2_PACKAGE_MBPFAN
	bool "mbpfan"
	depends on BR2_USE_MMU
	help
	  mbpfan is a utility which controls the macbook pro fans.

	  https://github.com/linux-on-mac/mbpfan
```

## configs/apps/ttyd/buildroot_ext/package/ttyd/Config.in
```kconfig
config BR2_PACKAGE_TTYD
	bool "ttyd"
	depends on BR2_USE_MMU
	select BR2_PACKAGE_JSON_C
	select BR2_PACKAGE_LIBOPENSSL
	select BR2_PACKAGE_LIBWEBSOCKETS
	help
	  ttyd is a command-line tool for sharing terminal over the web.

	  https://github.com/tsl0922/ttyd
```

## configs/bananapi/common/buildroot_ext/package/bananapi-m1-firmware/Config.in
```kconfig
config BR2_PACKAGE_BANANAPI_M1_FIRMWARE
	bool "bananapi-m1-firmware"
	help
	  Bananapi M1 extra firmware. 

	  https://github.com/paralin/BPI-Mainline-bsp
```

## configs/core/alpine/buildroot_ext/package/skiff-core-alpine/Config.in
```kconfig
config BR2_PACKAGE_SKIFF_CORE_ALPINE
	bool "skiff-core-alpine"
	depends on BR2_PACKAGE_HOST_GO_TARGET_ARCH_SUPPORTS
	depends on BR2_PACKAGE_HOST_GO_TARGET_CGO_LINKING_SUPPORTS
	depends on BR2_TOOLCHAIN_HAS_THREADS
	depends on !BR2_TOOLCHAIN_USES_UCLIBC # docker-containerd -> runc
	depends on BR2_USE_MMU # docker-containerd
	select BR2_PACKAGE_DOCKER_ENGINE # skiff-core
	select BR2_PACKAGE_CONTAINERD # skiff-core
	select BR2_PACKAGE_DOCKER_PROXY # skiff-core
	select BR2_PACKAGE_SKIFF_CORE
	select BR2_PACKAGE_SKIFF_CORE_DEFCONFIG
	help
	  Skiff Core environment defconfig with Alpine Linux.

	  https://github.com/skiffos/skiff-core

comment "skiff-core-alpine needs a glibc toolchain w/ threads"
	depends on BR2_PACKAGE_HOST_GO_TARGET_ARCH_SUPPORTS
	depends on BR2_PACKAGE_HOST_GO_TARGET_CGO_LINKING_SUPPORTS
	depends on !BR2_TOOLCHAIN_HAS_THREADS || !BR2_TOOLCHAIN_USES_GLIBC
```

## configs/core/arch/buildroot_ext/package/skiff-core-arch/Config.in
```kconfig
config BR2_PACKAGE_SKIFF_CORE_ARCH
	bool "skiff-core-arch"
	depends on BR2_PACKAGE_HOST_GO_TARGET_ARCH_SUPPORTS
	depends on BR2_PACKAGE_HOST_GO_TARGET_CGO_LINKING_SUPPORTS
	depends on BR2_TOOLCHAIN_HAS_THREADS
	depends on !BR2_TOOLCHAIN_USES_UCLIBC # docker-containerd -> runc
	depends on BR2_USE_MMU # docker-containerd
	select BR2_PACKAGE_SKIFF_CORE
	select BR2_PACKAGE_SKIFF_CORE_DEFCONFIG
	help
	  Skiff Core environment with Arch Linux.

	  https://archlinux.org

comment "skiff-core-arch needs a glibc toolchain w/ threads"
	depends on BR2_PACKAGE_HOST_GO_TARGET_ARCH_SUPPORTS
	depends on BR2_PACKAGE_HOST_GO_TARGET_CGO_LINKING_SUPPORTS
	depends on !BR2_TOOLCHAIN_HAS_THREADS || !BR2_TOOLCHAIN_USES_GLIBC
```

## configs/core/cachyos/buildroot_ext/package/skiff-core-cachyos/Config.in
```kconfig
config BR2_PACKAGE_SKIFF_CORE_CACHYOS
	bool "skiff-core-cachyos"
	depends on BR2_PACKAGE_HOST_GO_TARGET_ARCH_SUPPORTS
	depends on BR2_PACKAGE_HOST_GO_TARGET_CGO_LINKING_SUPPORTS
	depends on BR2_TOOLCHAIN_HAS_THREADS
	depends on !BR2_TOOLCHAIN_USES_UCLIBC # docker-containerd -> runc
	depends on BR2_USE_MMU # docker-containerd
	select BR2_PACKAGE_SKIFF_CORE
	select BR2_PACKAGE_SKIFF_CORE_DEFCONFIG
	help
	  Skiff Core environment with CachyOS Linux.

	  https://cachyos.org

comment "skiff-core-cachyos needs a glibc toolchain w/ threads"
	depends on BR2_PACKAGE_HOST_GO_TARGET_ARCH_SUPPORTS
	depends on BR2_PACKAGE_HOST_GO_TARGET_CGO_LINKING_SUPPORTS
	depends on !BR2_TOOLCHAIN_HAS_THREADS || !BR2_TOOLCHAIN_USES_GLIBC
```

## configs/core/debian/buildroot_ext/package/skiff-core-debian/Config.in
```kconfig
config BR2_PACKAGE_SKIFF_CORE_DEBIAN
	bool "skiff-core-debian"
	depends on BR2_PACKAGE_HOST_GO_TARGET_ARCH_SUPPORTS
	depends on BR2_PACKAGE_HOST_GO_TARGET_CGO_LINKING_SUPPORTS
	depends on BR2_TOOLCHAIN_HAS_THREADS
	depends on !BR2_TOOLCHAIN_USES_UCLIBC # docker-containerd -> runc
	depends on BR2_USE_MMU # docker-containerd
	select BR2_PACKAGE_SKIFF_CORE
	select BR2_PACKAGE_SKIFF_CORE_DEFCONFIG
	help
	  Skiff Core environment for Debian Bullseye.
```

## configs/core/dietpi/buildroot_ext/package/skiff-core-diet-pi/Config.in
```kconfig
config BR2_PACKAGE_SKIFF_CORE_DIET_PI
	bool "skiff-core-diet-pi"
	depends on BR2_PACKAGE_HOST_GO_TARGET_ARCH_SUPPORTS
	depends on BR2_PACKAGE_HOST_GO_TARGET_CGO_LINKING_SUPPORTS
	depends on BR2_TOOLCHAIN_HAS_THREADS
	depends on !BR2_TOOLCHAIN_USES_UCLIBC # docker-containerd -> runc
	depends on BR2_USE_MMU # docker-containerd
	select BR2_PACKAGE_SKIFF_CORE
	select BR2_PACKAGE_SKIFF_CORE_DEFCONFIG
	help
	  Skiff Core environment for DietPi on Ubuntu.

	  https://github.com/MichaIng/DietPi
```
